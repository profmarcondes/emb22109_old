## external/Config.in
```kconfig
# Place holder for load packages Config.in
menu "Games"
#	source "$BR2_EXTERNAL_EMB22109_PATH/package/ninvaders/Config.in"
endmenu
menu "Libraries"
#	source "$BR2_EXTERNAL_EMB22109_PATH/package/libfoo/Config.in"
endmenu
```

## external/libfoo/Config.in
```kconfig
config BR2_PACKAGE_LIBFOO
	bool "libfoo"
	help
	  This is a completely stupid piece of source code doing absolutely nothing useful. It is only intended to be used as an exercice for packaging software in Buildroot.

	  https://github.com/tpetazzoni/libfoo
```

## external/ninvaders/Config.in
```kconfig
config BR2_PACKAGE_NINVADERS
	bool "ninvaders"
	select BR2_PACKAGE_NCURSES
	help
	  Pacote do programa nInvaders implementado com nCurses

	  https://sourceforge.net/projects/ninvaders/
```
